#include "stm8s.h"
#include "spi.h"
#include "stm8s_spi.h"

/*********************************************************************************************************
** Function name: SPIInit          
** Descriptions: SPI初始化    
** input parameters:     
** Returned value: 
**--------------------------------------------------------------------------------------------------------
** Modified by:             
** Modified date:          
** Descriptions:             
**--------------------------------------------------------------------------------------------------------
*********************************************************************************************************/
void SPIInit(void)
{
    SPI->CR2 = 3;
    SPI->CR1 = (1<<2) | (1<<3);
    SPI->CRCPR = 0x07;
    SPI->CR1 |= (1<<6);
}

/*********************************************************************************************************
** Function name: spiLoopSendReceive          
** Descriptions: SPI回环发送, 即发送一字节,接收一字节    
** input parameters: port:端口 ucData:发送的数据    
** Returned value: SPI接收到的数据
**--------------------------------------------------------------------------------------------------------
** Modified by:             
** Modified date:          
** Descriptions:             
**--------------------------------------------------------------------------------------------------------
*********************************************************************************************************/
u8 spiLoopSendReceive(u8 ucData)
{
    u16 usTimeOut = 0;
    u8 ucDataTemp = 0;

    while (((SPI->SR) & SPI_SR_TXE) == 0) {  /* 等待SPI可发送 */
        if (usTimeOut++ > 5000) {
            break; // 超时退出
        }
    }
    SPI->DR = ucData;  /* SPI发送数据 */
    usTimeOut = 0;
    while (((SPI->SR) & SPI_SR_RXNE) == 0) {  /* 等待SPI发送完成 */
        if (usTimeOut++ > 5000) {
            break; // // 超时退出
        }
    }
    ucDataTemp = (SPI->DR); /* SPI接收数据 */
    return ucDataTemp;
}
/*********************************************************************************************************
** Function name: spiSendData          
** Descriptions: SPI发送数据    
** input parameters:     
** Returned value: 
**--------------------------------------------------------------------------------------------------------
** Modified by:             
** Modified date:          
** Descriptions:             
**--------------------------------------------------------------------------------------------------------
*********************************************************************************************************/
void spiSendData(u8* pucDataBuf, u8 ucCnt)
{
    u8 i;
    //disableInterrupts();
    for (i = 0; i < ucCnt; i++) {
        (void)spiLoopSendReceive(pucDataBuf[i]);
    }
    //enableInterrupts();
}
/*********************************************************************************************************
** Function name: spiGetData          
** Descriptions:     
** input parameters:     
** Returned value: 
**--------------------------------------------------------------------------------------------------------
** Modified by:             
** Modified date:          
** Descriptions:             
**--------------------------------------------------------------------------------------------------------
*********************************************************************************************************/
void spiGetData(u8* pucDataBuf, u8 ucCnt)
{
    u8 i = 0;
    //disableInterrupts();
    for (i = 0; i < ucCnt; i++) {
        pucDataBuf[i] = spiLoopSendReceive(0xFF);
    }
    //enableInterrupts();
}


